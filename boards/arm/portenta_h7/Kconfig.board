## boards/arm/portenta_h7/Kconfig.board
```kconfig
# SPDX-License-Identifier: Apache-2.0

config BOARD_PORTENTA_H7_M7
	bool "ARDUINO PORTENTA H7 M7 Development Board"
	depends on SOC_STM32H747XX
	select CPU_CORTEX_M7

config BOARD_PORTENTA_H7_M4
	bool "ARDUINO PORTENTA H7 M4 Development Board"
	depends on SOC_STM32H747XX
	select CPU_CORTEX_M4
```

## boards/arm/portenta_h7/Kconfig.defconfig
```kconfig
# SPDX-License-Identifier: Apache-2.0

if BOARD_PORTENTA_H7_M7 || BOARD_PORTENTA_H7_M4

config BOARD
	default "portenta_h7_m7" if BOARD_PORTENTA_H7_M7
	default "portenta_h7_m4" if BOARD_PORTENTA_H7_M4

config STM32H7_DUAL_CORE
	default y

if NETWORKING

config NET_L2_ETHERNET
	default y

endif # NETWORKING

endif
```

## boards/arm/portenta_h7/portenta_h7_m7_defconfig
```kconfig
# SPDX-License-Identifier: Apache-2.0

CONFIG_SOC_SERIES_STM32H7X=y
CONFIG_SOC_STM32H747XX=y

# Board config should be specified since there are 2 possible targets
CONFIG_BOARD_PORTENTA_H7_M7=y

# Enable the External SMPS regulator
CONFIG_POWER_SUPPLY_SMPS_1V8_SUPPLIES_LDO=y

# enable pinmux
CONFIG_PINMUX=y

# enable GPIO
CONFIG_GPIO=y
CONFIG_PINCTRL=y

# Enable clocks
CONFIG_CLOCK_CONTROL=y
CONFIG_CLOCK_CONTROL_INIT_PRIORITY=3

# Enable MPU
CONFIG_ARM_MPU=y

# Enable HW stack protection
CONFIG_HW_STACK_PROTECTION=y

# default use code partition
CONFIG_USE_DT_CODE_PARTITION=y

# Disable following to assign serial ports to m4 core

# enable uart driver
CONFIG_SERIAL=y

# console
CONFIG_CONSOLE=y
CONFIG_UART_CONSOLE=y

# enable gpio led driver
CONFIG_LED=y
CONFIG_LED_GPIO=y


CONFIG_I2C=y

CONFIG_USB_DEVICE_STACK=y
CONFIG_USB_CDC_ACM=y
```

## modules/wifi/dts/bindings/st,stm32-wifi-whd-sdio.yaml
```yaml
description: stm32 sdmmc disk access

compatible: st,stm32-wifi-whd-sdio

include: [mmc.yaml, pinctrl-device.yaml]

properties:
    clocks:
        required: true

    label:
        required: true

    reg:
        required: true

    pinctrl-0:
      required: true

    pinctrl-names:
      required: true

    wakeup-gpios:
        type: phandle-array
        required: false
        description: wifi host wakeup pin

    pwr-gpios:
        type: phandle-array
        required: false
        description: Power pin
```

## tests/testcase.yaml
```yaml
tests:
  portenta.drivers.sdram:
    tags: drivers memc
    depends_on: memc
    filter: dt_compat_enabled("st,stm32-fmc-sdram")
```
